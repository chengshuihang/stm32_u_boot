## board/st/stm32f407-qmx/Kconfig
```kconfig
if TARGET_STM32F407_QMX

config SYS_BOARD
	string
	default "stm32f407-qmx"

config SYS_VENDOR
	string
	default "st"

config SYS_SOC
	string
	default "stm32f4"

config SYS_CONFIG_NAME
	string
	default "stm32f407-qmx"

endif
```
